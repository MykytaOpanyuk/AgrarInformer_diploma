## meta_layers/meta-agroinformer/conf/layer.conf
```bitbake
# We have a conf and classes directory, add to BBPATH
BBPATH .= ":${LAYERDIR}"

# We have recipes-* directories, add to BBFILES
BBFILES += "${LAYERDIR}/recipes-*/*/*.bb \
            ${LAYERDIR}/recipes-*/*/*.bbappend"

BBFILE_COLLECTIONS += "meta-agroinformer"
BBFILE_PATTERN_meta-agroinformer = "^${LAYERDIR}/"
BBFILE_PRIORITY_meta-agroinformer = "6"

LAYERDEPENDS_meta-agroinformer = "core"
LAYERSERIES_COMPAT_meta-agroinformer = "warrior zeus"
```

## meta_layers/meta-dht11/conf/layer.conf
```bitbake
# We have a conf and classes directory, add to BBPATH
BBPATH .= ":${LAYERDIR}"

# We have recipes-* directories, add to BBFILES
BBFILES += "${LAYERDIR}/recipes-*/*/*.bb \
            ${LAYERDIR}/recipes-*/*/*.bbappend"

BBFILE_COLLECTIONS += "meta-dht11"
BBFILE_PATTERN_meta-dht11 = "^${LAYERDIR}/"
BBFILE_PRIORITY_meta-dht11 = "6"

LAYERDEPENDS_meta-dht11 = "core"
LAYERSERIES_COMPAT_meta-dht11 = "warrior zeus"
```

## meta_layers/meta-diode_button/conf/layer.conf
```bitbake
# We have a conf and classes directory, add to BBPATH
BBPATH .= ":${LAYERDIR}"

# We have recipes-* directories, add to BBFILES
BBFILES += "${LAYERDIR}/recipes-*/*/*.bb \
            ${LAYERDIR}/recipes-*/*/*.bbappend"

BBFILE_COLLECTIONS += "meta-diode_button_driver"
BBFILE_PATTERN_meta-dht11 = "^${LAYERDIR}/"
BBFILE_PRIORITY_meta-dht11 = "6"

LAYERDEPENDS_meta-diode_button_driver = "core"
LAYERSERIES_COMPAT_meta-diode_button_driver = "warrior zeus"
```
